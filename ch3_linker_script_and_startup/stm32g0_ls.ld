ENTRY(reset_handler)

MEMORY {
    FLASH(rx) : ORIGIN = 0x08000000, LENGTH = 128K
    SRAM(rwx) : ORIGIN = 0x20000000, LENGTH = 36K
}

endStack = ORIGIN(SRAM) + LENGTH(SRAM)

/* Stolen from autogenerated file because could not find value in datasheet */
minHeapSize = 0x200; 
minStackSize = 0x400;